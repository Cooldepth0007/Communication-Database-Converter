AUTOSAR XML (schema 4.0)
package /SamplePackage
  can cluster CAN_Cluster
  can frame VehicleStatusFrame: frame-length=8
  i signal VehicleSpeed: length=16, unit=kmh
  ecu instance Gateway
