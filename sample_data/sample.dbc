VERSION ""

NS_ :

BS_:
BU_: EngineECU Dashboard

BO_ 256 EngineData: 8 EngineECU
 SG_ EngineSpeed : 0|16@1+ (0.125,0) [0|8000] "rpm" Dashboard
 SG_ CoolantTemp : 16|8@1- (1,-40) [-40|215] "degC" Dashboard
